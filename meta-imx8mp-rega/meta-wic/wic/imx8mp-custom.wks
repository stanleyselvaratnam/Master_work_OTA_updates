## meta-imx8mp-rega/meta-wic/wic/imx8mp-custom.wks
```
# imx8mp-custom.wks - adaptatif pour uboot.env, boot, rootfs, persist, backup

# Partition 1: U-Boot environment
part --source rawcopy --sourceparams="file=uboot.env" --ondisk mmcblk1 --align 4096 --no-table

# Partition 2: Boot partition (kernel FIT + DTBs)
part --source rawcopy --sourceparams="file=${IMGDEPLOYDIR}/${IMAGE_LINK_NAME}.bootimg" --ondisk mmcblk1 --align 4096 --fixed-size 100M --active --label boot --part-type EF00

# Partition 3: Rootfs A (avec dm-verity intégré)
part --source rawcopy --sourceparams="file=${IMGDEPLOYDIR}/${IMAGE_LINK_NAME}.ext4.verity" --ondisk mmcblk1 --align 4096 --part-type=0FC63DAF-8483-4772-8E79-3D69D8477DE4

# Partition 4: Rootfs B (vide pour A/B updates)
part --ondisk mmcblk1 --align 4096 --fixed-size 4000M --label rootfsB --part-type=0FC63DAF-8483-4772-8E79-3D69D8477DE4

# Partition 5: Data persistante
part --source rawcopy --sourceparams="file=${IMGDEPLOYDIR}/${IMAGE_LINK_NAME}.dataimg" --ondisk mmcblk1 --align 4096 --fixed-size 512M --part-type=0FC63DAF-8483-4772-8E79-3D69D8477DE4

# Partition 6: Backup
part --source rawcopy --sourceparams="file=${DEPLOY_DIR_IMAGE}/backup.img" --ondisk mmcblk1 --align 4096 --fixed-size 512M --part-type=0FC63DAF-8483-4772-8E79-3D69D8477DE4

bootloader --ptable gpt
```

## meta-my-layer/meta-binutils/conf/layer.conf
```bitbake
# We have a conf and classes directory, add to BBPATH
BBPATH .= ":${LAYERDIR}"
BBFILES += "${LAYERDIR}/recipes-*/*/*.bb ${LAYERDIR}/recipes-*/*/*.bbappend"

# This should match your layer priority
LAYER_PRIORITY_my-layer = "6"

# Optional: any other layer-specific variables
LAYERVERSION_my-layer = "1"
```

## meta-my-layer/meta-kernel-custom/conf/layer.conf
```bitbake
# meta-kernel-custom/conf/layer.conf

BBFILES += "${LAYERDIR}/recipes-*/*/*/*.bb \
            ${LAYERDIR}/recipes-*/*/*/*.bbappend"

# Nom de la collection de recettes pour ce layer
BBFILE_COLLECTIONS += "meta-kernel-custom"

# Où trouver les recettes pour ce layer
BBFILE_PATTERN_meta-kernel-custom := "^${LAYERDIR}/"

# Priorité du layer (plus haute priorité écrase les autres)
BBFILE_PRIORITY_meta-kernel-custom := "6"

LAYER_CONF_VERSION = "7"

# Liste les versions Yocto compatibles (par exemple "zeus", "hardknott", etc.)
LAYERSERIES_COMPAT_meta-kernel-custom = "scarthgap"
```

## meta-my-layer/meta-myapps/conf/layer.conf
```bitbake
# meta-myapps/conf/layer.conf
LCONF_VERSION = "7"
BBPATH .= ":${LAYERDIR}"
BBFILES += "${LAYERDIR}/recipes-*/*/*.bb"
BBFILE_COLLECTIONS += "myapps"
BBFILE_PATTERN_myapps = "^${LAYERDIR}/"
BBFILE_PRIORITY_myapps = "6"

# Indique les versions de poky compatibles
LAYERSERIES_COMPAT_myapps = "scarthgap"
```
